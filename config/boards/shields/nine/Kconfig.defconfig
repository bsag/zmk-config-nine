## config/boards/shields/nine/Kconfig.defconfig
```kconfig
# Copyright (c) 2022 The ZMK Contributors
# SPDX-License-Identifier: MIT

if SHIELD_NINE_LEFT

config ZMK_KEYBOARD_NAME
    default "Nine No Screens"

config ZMK_SPLIT_ROLE_CENTRAL
    default y

endif

if SHIELD_NINE_LEFT || SHIELD_NINE_RIGHT
config ZMK_SPLIT
    default y
endif
```

## config/boards/shields/nine/Kconfig.shield
```kconfig
# Copyright (c) 2022 The ZMK Contributors
# SPDX-License-Identifier: MIT

config SHIELD_NINE_LEFT
    def_bool $(shields_list_contains,nine_left)

config SHIELD_NINE_RIGHT
    def_bool $(shields_list_contains,nine_right)
```
